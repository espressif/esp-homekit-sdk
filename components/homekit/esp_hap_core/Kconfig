## components/homekit/esp_hap_core/Kconfig
```kconfig
menu "HomeKit"

    config HAP_MFI_ENABLE
        bool "Enable MFi"
        default n
        help
            If you have the MFi variant of the SDK, set this to true to use features like
            HW authentication, software token authentication and WAC.

    config HAP_SESSION_KEEP_ALIVE_ENABLE
        bool "Enable Keep Alive on sessions"
        default n
        depends on !HAP_MFI_ENABLE
        help
            Enable Keep Alive on Controller Sessions so that stale connections do not stay
            open indefinitely. Note that the HomeKit Specs do not allow this and so, this
            should be enabled at your own risk. Even without this option, the HomeKit core
            will close stale session using the HTTP Server's Least Recently Used (LRU) purge
            logic.

endmenu
```

## components/homekit/esp_hap_platform/Kconfig
```kconfig
menu "MFi I2C Setup"

    choice
        prompt "Choose Data Rate"
        default DR_400 if IDF_TARGET_ESP32
        default DR_100 if IDF_TARGET_ESP32S2
        config DR_400
            bool "400 kbit/s"
        config DR_100
            bool "100 kbit/s"
    endchoice

    config IC2_SPEED
        int
        default 400000 if DR_400
        default 100000 if DR_100
        help
            Set the i2c datarate

    config SDA_GPIO
        int "SDA GPIO"
        default 26 if IDF_TARGET_ESP32
        default 4 if IDF_TARGET_ESP32S2
        default 5 if IDF_TARGET_ESP32C3
        default 2 if IDF_TARGET_ESP8266
        default 4
        help
            GPIO for SDA - please check schematic carefully

    config SCL_GPIO
        int "SCL GPIO"
        default 27 if IDF_TARGET_ESP32
        default 5 if IDF_TARGET_ESP32S2
        default 6 if IDF_TARGET_ESP32C3
        default 14 if IDF_TARGET_ESP8266
        default 5
        help
            GPIO for SCL - please check schematic carefully

    config I2C_MAX_READ_COUNT
        int "Max read count"
        range 50 300
        default 150
        help
            Set the max read count

    config I2C_RETRY_COUNT
        int "Retry Count"
        default 200
        help
            Set the number of retries for an I2C interface

endmenu

menu "HAP HTTP Server"

    config HAP_HTTP_STACK_SIZE
        int "Server Stack Size"
        default 12288
        range 8192 32768
        help
            Set the stack size for the HomeKit HTTP Server thread.

    config HAP_HTTP_SERVER_PORT
        int "Server Port"
        default 80
        help
            Set the HomeKit HTTP Server Port number.

    config HAP_HTTP_CONTROL_PORT
        int "Server Control Port"
        default 32859
        help
            Set the HomeKit HTTP Server UDP Control Port which is used for internl communication.

    config HAP_HTTP_MAX_OPEN_SOCKETS
        int "Max Open Sockets"
        default 8
        range 2 24
        help
            Set the Maximum simultaneous Open Sockets that the HTTP Server should allow.
            A minimum of 8 is required for HomeKit Certification.

    config HAP_HTTP_MAX_URI_HANDLERS
        int "Max URI Handlers"
        default 16
        range 12 32
        help
            Set the Maximum number of URI handlers that the HTTP Server should allow.

endmenu

menu "HAP Platform Keystore"

    config HAP_PLATFORM_DEF_NVS_RUNTIME_PARTITION
        string "Runtime NVS partition name"
        default "nvs"
        help
            Set the runtime NVS partition name for HomeKit use.

    config HAP_PLATFORM_DEF_NVS_FACTORY_PARTITION
        string "Factory NVS partition name"
        default "factory_nvs"
        help
            Set the factory NVS partition name for HomeKit use.

endmenu
```

## examples/aws-iot/main/Kconfig.projbuild
```kconfig
menu "AWS-IoT Example Configuration"

    config EXAMPLE_USE_HARDCODED_SETUP_CODE
        bool "Use hard-coded setup code"
        default y
        help
            HomeKit does not recommend having the setup code programmed in the accessory as is.
            Instead, it expects setup info (salt-verifier pair) generated for the given setup code.
            Use this option only for testing purposes. For production, the setup info should be
            used.

    config EXAMPLE_SETUP_CODE
        string "HomeKit Setup Code"
        default "111-22-333"
        depends on EXAMPLE_USE_HARDCODED_SETUP_CODE
        help
            Setup code to be used for HomeKot pairing, if hard-coded setup code is enabled.

    config EXAMPLE_SETUP_ID
        string "HomeKit Setup Id"
        default "ES32"
        depends on EXAMPLE_USE_HARDCODED_SETUP_CODE
        help
            Setup id to be used for HomeKot pairing, if hard-coded setup code is enabled.

    config EXAMPLE_AWS_CLIENT_ID
        string "Client Id"
        default "MyClient"
        help
            The Client Id to be used for AWS-IoT MQTT connection

    choice EXAMPLE_AWS_COMMUNICATION_MECHANISM
        bool "AWS IoT Communication mechanism"
        default EXAMPLE_AWS_THING_SHADOW
        help
            AWS IoT can use plain MQTT publish/subscribe or the AWS proprietary Thing/Shadow
            for communicating with the AWS IoT MQTT broker. Choose the option you want to use.

        config EXAMPLE_AWS_THING_SHADOW
            bool "Thing-Shadow"
        config EXAMPLE_AWS_PUB_SUB
            bool "Publish-Subscribe"
    endchoice

    config EXAMPLE_AWS_COMMUNICATION_MECHANISM
        int
        default 1 if EXAMPLE_AWS_THING_SHADOW
        default 2 if EXAMPLE_AWS_PUB_SUB

    menu "Publish-Subscribe"
        depends on EXAMPLE_AWS_PUB_SUB

        config EXAMPLE_AWS_PUBLISH_TOPIC
            string "MQTT Publish Topic"
            default "device/publish"
            help
                The MQTT topic to which the accessory should publish the state changes

        config EXAMPLE_AWS_SUBSCRIBE_TOPIC
            string "MQTT Subscribe Topic"
            default "device/subscribe"
            help
                The MQTT topic on which the accessory will receive state change messages from
                the cloud

    endmenu # Publish-Subscribe
endmenu
```

## examples/common/app_wifi/Kconfig.projbuild
```kconfig
menu "App Wi-Fi"

    choice APP_WIFI_CRED_SOURCE
        bool "Source of Wi-Fi Credentials"
        default APP_WIFI_USE_PROVISIONING
        help
            Wi-Fi credentials can either be hard-coded or provided using Provisioning.

        config APP_WIFI_USE_PROVISIONING
            bool "Use Provisioning"
        config APP_WIFI_USE_HARDCODED
            bool "Use Hardcoded"
    endchoice

    config APP_WIFI_CRED_SOURCE
        int
        default 1 if APP_WIFI_USE_PROVISIONING
        default 2 if APP_WIFI_USE_HARDCODED


    config APP_WIFI_SSID
        string "WiFi SSID"
        default "myssid"
        depends on APP_WIFI_USE_HARDCODED
        help
            SSID (network name) for the example to connect to.

    config APP_WIFI_PASSWORD
        string "WiFi Password"
        default "mypassword"
        depends on APP_WIFI_USE_HARDCODED
        help
            WiFi password (WPA or WPA2) for the example to use.

    choice APP_WIFI_PROVISIONING_TYPE
        bool "Provisioning Type"
        default APP_WIFI_USE_UNIFIED_PROVISIONING
        depends on APP_WIFI_USE_PROVISIONING
        help
            The type of Provisioning to Use.

        config APP_WIFI_USE_UNIFIED_PROVISIONING
            bool "Unified Provisioning"
        config APP_WIFI_USE_WAC_PROVISIONING
            bool "Apple WAC Provisioning"
            depends on HAP_MFI_ENABLE
        config APP_WIFI_USE_BOTH_PROVISIONING
            bool "Use Both"
            depends on HAP_MFI_ENABLE
    endchoice

    config APP_WIFI_PROVISIONING_TYPE
        int
        default 1 if APP_WIFI_USE_UNIFIED_PROVISIONING
        default 2 if APP_WIFI_USE_WAC_PROVISIONING
        default 3 if APP_WIFI_USE_BOTH_PROVISIONING

    config APP_WIFI_PROV_SHOW_QR
        bool "Show provisioning QR code"
        depends on APP_WIFI_USE_UNIFIED_PROVISIONING || APP_WIFI_USE_BOTH_PROVISIONING
        default y
        help
            Show the QR code for provisioning.

    choice APP_WIFI_PROV_TRANSPORT
        bool "Provisioning Transport method"
        default APP_WIFI_PROV_TRANSPORT_BLE
        depends on APP_WIFI_USE_UNIFIED_PROVISIONING || APP_WIFI_USE_BOTH_PROVISIONING
        help
            Wi-Fi provisioning component offers both, SoftAP and BLE transports. Choose any one.

        config APP_WIFI_PROV_TRANSPORT_SOFTAP
            bool "Soft AP"
        config APP_WIFI_PROV_TRANSPORT_BLE
            bool "BLE"
            select BT_ENABLED
            depends on !IDF_TARGET_ESP32S2
    endchoice

    config APP_WIFI_PROV_TRANSPORT
        int
        default 1 if APP_WIFI_PROV_TRANSPORT_SOFTAP
        default 2 if APP_WIFI_PROV_TRANSPORT_BLE

    config APP_WIFI_PROV_USING_BLUEDROID
        bool
        depends on (BT_BLUEDROID_ENABLED && (IDF_TARGET_ESP32C3 || IDF_TARGET_ESP32S3))
        select BT_BLE_42_FEATURES_SUPPORTED
        default y
        help
            This enables BLE 4.2 features for Bluedroid.

endmenu
```

## examples/data_tlv8/main/Kconfig.projbuild
```kconfig
menu "Example Configuration"

    config EXAMPLE_USE_HARDCODED_SETUP_CODE
        bool "Use hard-coded setup code"
        default y
        help
            HomeKit does not recommend having the setup code programmed in the accessory as is.
            Instead, it expects setup info (salt-verifier pair) generated for the given setup code.
            Use this option only for testing purposes. For production, the setup info should be
            used.

    config EXAMPLE_SETUP_CODE
        string "HomeKit Setup Code"
        default "111-22-333"
        depends on EXAMPLE_USE_HARDCODED_SETUP_CODE
        help
            Setup code to be used for HomeKot pairing, if hard-coded setup code is enabled.

    config EXAMPLE_SETUP_ID
        string "HomeKit Setup Id"
        default "ES32"
        depends on EXAMPLE_USE_HARDCODED_SETUP_CODE
        help
            Setup id to be used for HomeKot pairing, if hard-coded setup code is enabled.

endmenu
```

## examples/emulator/sdkconfig.defaults.esp32c5
```kconfig
# perform the size optimized builds for C6 to avoid app size overflow
CONFIG_COMPILER_OPTIMIZATION_SIZE=y
CONFIG_ESP_ROM_HAS_NEWLIB_NANO_FORMAT=y
```

## examples/emulator/sdkconfig.defaults.esp32c6
```kconfig
# perform the size optimized builds for C6 to avoid app size overflow
CONFIG_COMPILER_OPTIMIZATION_SIZE=y
```

## examples/led_strip/sdkconfig.defaults
```kconfig
CONFIG_PARTITION_TABLE_CUSTOM=y
CONFIG_PARTITION_TABLE_CUSTOM_FILENAME="partitions_hap.csv"
CONFIG_PARTITION_TABLE_CUSTOM_APP_BIN_OFFSET=0x10000
CONFIG_FREERTOS_UNICORE=y
CONFIG_FREERTOS_ASSERT_ON_UNTESTED_FUNCTION=n
CONFIG_FREERTOS_ASSERT_FAIL_ABORT=n
CONFIG_FREERTOS_ASSERT_DISABLE=y
CONFIG_LWIP_MAX_SOCKETS=16
CONFIG_LWIP_SO_REUSE=y
CONFIG_LWIP_MAX_ACTIVE_TCP=12
CONFIG_LWIP_MAX_LISTENING_TCP=12
CONFIG_LWIP_UDP_RECVMBOX_SIZE=10
CONFIG_MBEDTLS_HARDWARE_MPI=y
CONFIG_MBEDTLS_HARDWARE_SHA=n
CONFIG_ESP_TASK_WDT=n
CONFIG_LWIP_AUTOIP=y
CONFIG_ESPTOOLPY_FLASHSIZE_4MB=y
CONFIG_LWIP_AUTOIP_RATE_LIMIT_INTERVAL=60
CONFIG_MP_BLOB_SUPPORT=y
CONFIG_ENABLE_UNIFIED_PROVISIONING=y
```

## examples/smart_outlet/main/Kconfig.projbuild
```kconfig
menu "Example Configuration"

    config EXAMPLE_USE_HARDCODED_SETUP_CODE
        bool "Use hard-coded setup code"
        default y
        help
            HomeKit does not recommend having the setup code programmed in the accessory as is.
            Instead, it expects setup info (salt-verifier pair) generated for the given setup code.
            Use this option only for testing purposes. For production, the setup info should be
            used.

    config EXAMPLE_SETUP_CODE
        string "HomeKit Setup Code"
        default "111-22-333"
        depends on EXAMPLE_USE_HARDCODED_SETUP_CODE
        help
            Setup code to be used for HomeKot pairing, if hard-coded setup code is enabled.

    config EXAMPLE_SETUP_ID
        string "HomeKit Setup Id"
        default "ES32"
        depends on EXAMPLE_USE_HARDCODED_SETUP_CODE
        help
            Setup id to be used for HomeKot pairing, if hard-coded setup code is enabled.

    config OUTLET_GPIO
        int "Outlet GPIO number"
        range 0 34
        default 33
        help
            GPIO number (IOxx) to control relay pin.

            Some GPIOs are used for other purposes (flash connections, etc.) and cannot be used.
            
            Default is GPIO 33 (Built in Led on ESP32CAM by AI Thinker)

            GPIOs 35-39 are input-only so cannot be used as outputs.
            
    config OUTLET_IN_USE_GPIO
        int "Outlet in use GPIO number"
        range 0 34
        default 0
        help
            GPIO number (IOxx) to sense outlet in use.

            Some GPIOs are used for other purposes (flash connections, etc.) and cannot be used to blink.

            GPIOs 35-39 are input-only so cannot be used as outputs. 
endmenu
```

## examples/smart_outlet/sdkconfig.defaults
```kconfig
CONFIG_ESPTOOLPY_FLASHSIZE_4MB=y
CONFIG_PARTITION_TABLE_CUSTOM=y
CONFIG_PARTITION_TABLE_CUSTOM_FILENAME="partitions_hap.csv"
CONFIG_BT_ENABLED=y
CONFIG_BT_NIMBLE_ENABLED=y
CONFIG_FREERTOS_UNICORE=y
CONFIG_LWIP_MAX_SOCKETS=16
CONFIG_LWIP_AUTOIP=y
CONFIG_LWIP_AUTOIP_RATE_LIMIT_INTERVAL=60
CONFIG_LWIP_MAX_ACTIVE_TCP=12
CONFIG_LWIP_MAX_LISTENING_TCP=12
CONFIG_LWIP_UDP_RECVMBOX_SIZE=10
CONFIG_MBEDTLS_HARDWARE_SHA=n
CONFIG_MDNS_MAX_INTERFACES=1
CONFIG_MDNS_PREDEF_NETIF_STA=n
CONFIG_MDNS_PREDEF_NETIF_AP=n
CONFIG_MDNS_PREDEF_NETIF_ETH=n
```
